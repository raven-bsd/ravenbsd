// SPDX-License-Identifier: BSD-3-Clause
// Generated by tests/fixtures/pi4-emmc2/generate.py; values documented in README.md.
/dts-v1/;

/ {
    compatible = "raspberrypi,4-model-b", "brcm,bcm2711";
    model = "Raspberry Pi 4 Model B";
    #address-cells = <0x2>;
    #size-cells = <0x2>;
    soc {
        compatible = "simple-bus";
        #address-cells = <0x1>;
        #size-cells = <0x1>;
        ranges = <0x7e000000 0x0 0xfe000000 0x01800000>;
    };
    emmc2bus {
        compatible = "simple-bus";
        #address-cells = <0x2>;
        #size-cells = <0x1>;
        ranges = <0x0 0x7e000000 0x0 0xfe000000 0x01800000>;
        dma-ranges = <0x0 0xc0000000 0x0 0x0 0x40000000>;

        mmc@7e340000 {
            compatible = "brcm,bcm2711-emmc2";
            reg = <0x0 0x7e340000 0x100>;
            interrupts = <0x0 0x7e 0x0>;
            status = "okay";
        };
    };
};
