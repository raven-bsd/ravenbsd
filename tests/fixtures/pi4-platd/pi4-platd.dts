// SPDX-License-Identifier: BSD-3-Clause
// Copyright (c) 2026, Bo Maryniuk and RavenBSD contributors
// Generated by tests/fixtures/pi4-platd/generate.py.
/dts-v1/;

/ {
    compatible = "raven,pi4-platd-fixture";
    model = "RavenBSD Pi 4 platd fixture";
    #address-cells = <0x2>;
    #size-cells = <0x2>;
    platd@fd580000 {
        compatible = "raven,pi4-platform";
        reg = <0x0 0xfd580000 0x0 0x1000>,
              <0x0 0xfd581000 0x0 0x1000>,
              <0x0 0xfd582000 0x0 0x1000>;
        status = "okay";
    };
};
